## release/src-rt-6.x.4708/router/config/config.in
```kconfig
mainmenu "Tomato Configuration"

config TCONFIG_OPTIMIZE_SHARED_LIBS
	bool "Optimize shared libraries (remove unused symbols)"
	default y

config TCONFIG_L2TP
	bool "L2TP"
	default y

config TCONFIG_PPTP
	bool "PPTP"
	default y

config TCONFIG_PPTPD
	bool "PPTPD"
	depends on TCONFIG_PPTP
	default n

config TCONFIG_HTTPS
	bool "HTTPS"
	default y

config TCONFIG_SSH
	bool "SSH"
	default y

config TCONFIG_CIFS
	bool "CIFS Client"
	default y

config TCONFIG_JFFS2
	bool "JFFS Support"
	default y

config TCONFIG_JFFSV1
	bool "  Use JFFSv1 (if not selected, JFFS2 is used)"
	depends on TCONFIG_JFFS2
	default y

config TCONFIG_ZEBRA
	bool "Zebra"
	default y

config TCONFIG_DDNS
	bool "Dynamic DNS"
	default y

config TCONFIG_L7
	bool "Layer 7 Netfilter"
	default y

config TCONFIG_L7PAT
	bool "  Standard Layer 7 Patterns"
	depends on TCONFIG_L7
	default y

config TCONFIG_LZO
	bool "LZO Compression"
	default n

config TCONFIG_OPENVPN
	bool "OpenVPN"
	depends on TCONFIG_LZO
	default n

# !!TB
config TCONFIG_IPV6
	bool "IPv6 Support"
	default n

config TCONFIG_EBTABLES
	bool "Ebtables"
	default n

config TCONFIG_EMF
	bool "Broadcom EMF (Efficient Multicast Forwarding & IGMP Snooping)"
	default n

config TCONFIG_USB
	bool "USB Support"
	default y

config TCONFIG_NOCAT
	bool "NoCat Splash"
	default n

config TCONFIG_NGINX
	bool "NGinX Web Server"
	default n

config TCONFIG_MEDIA_SERVER
	bool "Media Server (MiniDLNA)"
	depends on TCONFIG_USB
	default n

config TCONFIG_FTP
	bool "  FTP Server"
	depends on TCONFIG_USB
	default y

config TCONFIG_FTP_SSL
	bool "    FTP SSL Support"
	depends on TCONFIG_FTP
	default n

config TCONFIG_SAMBASRV
	bool "  Samba File Sharing"
	depends on TCONFIG_USB
	default y

config TCONFIG_SAMBA3
       bool "    Compile with Samba 3"
       depends on TCONFIG_SAMBASRV
       default n

config TCONFIG_USB_EXTRAS
	bool "  Additional modules and utilities"
	depends on TCONFIG_USB
	default n

config TCONFIG_NTFS
	bool "  NTFS-3g Support"
	depends on TCONFIG_USB
	default n

config TCONFIG_BT
	bool "  Bittorrent client gui only"
	default n

config TCONFIG_BBT
	bool "  Bittorrent client binaries only"
	default n

config TCONFIG_TR_EXTRAS
	bool "  Transmission extra tools"
	default n
	depends on TCONFIG_BT

config TCONFIG_NFS
	bool "  NFS Server"
	default n

config TCONFIG_SNMP
	bool "  SNMP"
	default n

config TCONFIG_SDHC
	bool "  SDHC/MMC mod for WRT54G/GL"
	default n

config TCONFIG_HFS
	bool "  HFS/HFS+ filesystem support "
	default n

config TCONFIG_UPS
	bool "  UPS Monitor"
	depends on TCONFIG_USB
	default n

config TCONFIG_NANO
	bool "  NANO - user-friendly file editor"
	default n

config TCONFIG_DNSCRYPT
	bool "  DNScrypt-proxy"
	default n

config TCONFIG_NVRAM_64K
	bool "NVRAM_64K"
	default n

config TCONFIG_TOR
	bool "  TOR Project"
	default n

config TCONFIG_IPSEC
	bool "IPSec Support"
	default n

config TCONFIG_RAID
	bool "RAID Support: mdadm plus md modules"
	default n

config TCONFIG_MICROSD
	bool "Support SD card (RT-N66u only)"
	depends on TCONFIG_USB
	default n

config TCONFIG_USBAP
	bool "Include wl_high module"
	depends on TCONFIG_USB
	default n

config TCONFIG_REMOVE_USBAPP
	bool "Remove USB Application (samba/ftp/usb support page)"
	depends on TCONFIG_USBAP
	default n

config TCONFIG_AC66U
	bool "Flag to distinguish RT-AC66U from RT-N66U"
	default n

config TCONFIG_CTF
	bool "CTF (Cut-Through Forwarding)"
	default n

config TCONFIG_NAND
	bool "NAND flash support"
	default n

config TCONFIG_UFSDA
	bool "Paragon NTFS driver for Asus routers"
	default n

config TCONFIG_UFSDN
	bool "Paragon NTFS driver for Netgear routers"
	default n

config TCONFIG_TUXERA
	bool "Tuxera NTFS driver for Asus routers"
	default n

config TCONFIG_BCMARM
	bool "Bcm Arm"
	default n

config TCONFIG_BCMWL6
	bool "BCM WL 6"
	default n

config TCONFIG_BCMWL6A
	bool "BCM WL 6.30.143"
	depends on TCONFIG_BCMARM && TCONFIG_BCMWL6
	default n

config TCONFIG_BCM7
	bool "Bcm sdk 7"
	depends on TCONFIG_BCMARM
	default n

config TCONFIG_BCMSMP
	bool "BCM SMP"
	default n

config TCONFIG_AC3200
	bool "AC3200"
	default n

config TCONFIG_DHDAP
	bool "Bcm7 dhdap"
	default n

config TCONFIG_GMAC3
	bool "Bcm7 gmac3"
	default n

config TCONFIG_GROCTRL
	bool "GRO Control"
	default n

config TCONFIG_BCMFA
	bool "BCM FA"
	default n

config TCONFIG_BCMBSD
	bool "Brcm Band Steer Selection"
	default n

config TCONFIG_5301X
	bool "Bcm 5301x"
	default y

config TCONFIG_BCMDCS
	bool "Broadcom Dynamic Channel Selection"
	default n

config TCONFIG_TRAFFIC_MGMT_RSSI_POLICY
	bool "Traffic Management RSSI policy"
	default n

config TCONFIG_TOAD
	bool "Traffic Ordering Agent Daemon"
	default n

config TCONFIG_DNSSEC
	bool "DNSSEC"
	default n

config TCONFIG_TINC
	bool "TINC"
	default n

config TCONFIG_FANCTRL
	bool "FANCTRL"
 	default n
```

## release/src-rt/linux/linux-2.6/drivers/net/hnd/Kconfig
```kconfig
#
# Broadcom Home Networking Division (HND) driver configuration
#
# Copyright (C) 2009, Broadcom Corporation
# All Rights Reserved.
# 
# THIS SOFTWARE IS OFFERED "AS IS", AND BROADCOM GRANTS NO WARRANTIES OF ANY
# KIND, EXPRESS OR IMPLIED, BY STATUTE, COMMUNICATION OR OTHERWISE. BROADCOM
# SPECIFICALLY DISCLAIMS ANY IMPLIED WARRANTIES OF MERCHANTABILITY, FITNESS
# FOR A SPECIFIC PURPOSE OR NONINFRINGEMENT CONCERNING THIS SOFTWARE.
#
# $Id: Kconfig,v 1.5 2009/10/27 00:38:19 Exp $
#

menu "Broadcom HND network devices"
	depends on PCI
config HND
	bool "Broadcom HND network device support"
config ET
	tristate "10/100 Ethernet support"
	depends on HND
config ET_47XX
	bool "BCM47xx support"
	depends on ET
config BCM_CTF
	tristate "BCMCTF support"
	depends on HND
config WL_EMULATOR
	bool "WL emulation using Gigabit ethernet"
	depends on HND
config BCM57XX
	tristate "BCM57xx support is ON"
	depends on WL_EMULATOR
config WL
	tristate "Wireless feature variant is set to AP"
	depends on WL_EMULATOR
	select WL_USE_AP
config BCM57XX
	tristate "BCM57xx Gigabit Ethernet support"
	depends on HND && !WL_EMULATOR
config WL
	tristate "BCM43xx 802.11 Wireless support"
	depends on HND && !WL_EMULATOR
config WAPI
	bool "Wireless Authentication Privacy Infrastructure (WAPI) support"
	depends on HND && !WL_EMULATOR && WL
choice
	prompt "Wireless feature variant"
	depends on HND && !WL_EMULATOR && WL
config WL_USE_AP
	bool "Config file for basic AP variant"
config WL_USE_AP_SDSTD
	bool "Config file for basic AP sdstd variant"
config WL_USE_STA
	bool "Config file for basic STA variant"
config WL_USE_APSTA
	bool "Config file for basic APSTA variant"
config WL_USE_AP_ONCHIP_G
	bool "Config file for AP 1chipG variant"
config WL_USE_STA_ONCHIP_G
	bool "Config file for STA 1chipG variant"
config WL_USE_APSTA_ONCHIP_G
	bool "Config file for APSTA 1chipG variant"
config WL_USE_HIGH
	bool "Config file for high/bmac split variant"
endchoice
config EMF
	tristate "Efficient Multicast Forwarding & IGMP Snooping Layers"
	depends on NETFILTER
endmenu
```

## release/src/linux/linux/drivers/net/hnd/Config.in
```kconfig
#
# Broadcom Home Networking Division (HND) driver configuration
#
# Copyright 2006, Broadcom Corporation
# All Rights Reserved.
# 
# THIS SOFTWARE IS OFFERED "AS IS", AND BROADCOM GRANTS NO WARRANTIES OF ANY
# KIND, EXPRESS OR IMPLIED, BY STATUTE, COMMUNICATION OR OTHERWISE. BROADCOM
# SPECIFICALLY DISCLAIMS ANY IMPLIED WARRANTIES OF MERCHANTABILITY, FITNESS
# FOR A SPECIFIC PURPOSE OR NONINFRINGEMENT CONCERNING THIS SOFTWARE.
#

mainmenu_option next_comment
   comment 'Broadcom HND network devices'
   dep_bool 'Broadcom HND network device support' CONFIG_HND $CONFIG_PCI
   if [ "$CONFIG_HND" != "n" ]; then
      dep_tristate '  InsideLine HPNA support' CONFIG_IL $CONFIG_HND
      if [ "$CONFIG_IL" != "n" ]; then
         bool '    BCM42xx support' CONFIG_IL_42XX
         bool '    BCM47xx support' CONFIG_IL_47XX
         int '    LARQ buffer allocation (0 = tiny, 2 = huge)' CONFIG_LARQ_BUF 0
      fi
      dep_tristate '  10/100 Ethernet support' CONFIG_ET $CONFIG_HND 
      if [ "$CONFIG_ET" != "n" ]; then
         bool '    BCM47xx support' CONFIG_ET_47XX
      fi
      dep_tristate '  WL emulation using Gigabit ethernet' CONFIG_WL_EMULATOR $CONFIG_HND
      if [ "$CONFIG_WL_EMULATOR" != "n" ]; then
         comment '    BCM57xx support is ON'
         define_tristate CONFIG_BCM57XX $CONFIG_WL_EMULATOR
         comment '    Wireless feature variant is set to AP'
         define_tristate CONFIG_WL $CONFIG_WL_EMULATOR
         define_bool CONFIG_WL_USE_AP y
      else
         dep_tristate '  BCM57xx Gigabit Ethernet support' CONFIG_BCM57XX $CONFIG_HND
         dep_tristate '  BCM43xx 802.11 Wireless support' CONFIG_WL $CONFIG_HND
         if [ "$CONFIG_WL" != "n" ]; then
            choice '    Wireless feature variant' \
               "ap	CONFIG_WL_USE_AP \
                apsta	CONFIG_WL_USE_APSTA"
            string '    Config file for basic AP variant' \
			CONFIG_WL_AP wlconfig_lx_router_ap
            string '    Config file for basic STA variant' \
			CONFIG_WL_APSTA wlconfig_lx_router_apsta
         fi
      fi
   fi
endmenu
```

## release/src/router/config/config.in
```kconfig
mainmenu "Tomato Configuration"

config TCONFIG_OPTIMIZE_SHARED_LIBS
	bool "Optimize shared libraries (remove unused symbols)"
	default y

config TCONFIG_L2TP
	bool "L2TP"
	default y

config TCONFIG_PPTP
	bool "PPTP"
	default y

config TCONFIG_PPTPD
	bool "PPTPD"
	depends on TCONFIG_PPTP
	default n

config TCONFIG_HTTPS
	bool "HTTPS"
	default y

config TCONFIG_SSH
	bool "SSH"
	default y

config TCONFIG_CIFS
	bool "CIFS Client"
	default y

config TCONFIG_JFFS2
	bool "JFFS Support"
	default y

config TCONFIG_JFFSV1
	bool "  Use JFFSv1 (if not selected, JFFS2 is used)"
	depends on TCONFIG_JFFS2
	default y

config TCONFIG_ZEBRA
	bool "Zebra"
	default y

config TCONFIG_DDNS
	bool "Dynamic DNS"
	default y

config TCONFIG_L7
	bool "Layer 7 Netfilter"
	default y

config TCONFIG_L7PAT
	bool "  Standard Layer 7 Patterns"
	depends on TCONFIG_L7
	default y

config TCONFIG_LZO
	bool "LZO Compression"
	default n

config TCONFIG_OPENVPN
	bool "OpenVPN"
	depends on TCONFIG_LZO
	default n

# !!TB
config TCONFIG_IPV6
	bool "IPv6 Support"
	default n

config TCONFIG_EBTABLES
	bool "Ebtables"
	default n

config TCONFIG_EMF
	bool "Broadcom EMF (Efficient Multicast Forwarding & IGMP Snooping)"
	default n

config TCONFIG_USB
	bool "USB Support"
	default y

config TCONFIG_NOCAT
	bool "NoCat Splash"
	default n

config TCONFIG_MEDIA_SERVER
	bool "Media Server (MiniDLNA)"
	depends on TCONFIG_USB
	default n

config TCONFIG_FTP
	bool "  FTP Server"
	depends on TCONFIG_USB
	default y

config TCONFIG_FTP_SSL
	bool "    FTP SSL Support"
	depends on TCONFIG_FTP
	default n

config TCONFIG_SAMBASRV
	bool "  Samba File Sharing"
	depends on TCONFIG_USB
	default y

config TCONFIG_SAMBA3
       bool "    Compile with Samba 3"
       depends on TCONFIG_SAMBASRV
       default n

config TCONFIG_USB_EXTRAS
	bool "  Additional modules and utilities"
	depends on TCONFIG_USB
	default n

config TCONFIG_NTFS
	bool "  NTFS-3g Support"
	depends on TCONFIG_USB
	default n

config TCONFIG_BT
	bool "  Bittorrent client gui only"
	default n

config TCONFIG_BBT
	bool "  Bittorrent client binaries only"
	default n

config TCONFIG_TR_EXTRAS
	bool "  Transmission extra tools"
	default n
	depends on TCONFIG_BT

config TCONFIG_NFS
	bool "  NFS Server"
	default n

config TCONFIG_SNMP
	bool "  SNMP"
	default n

config TCONFIG_SDHC
	bool "  SDHC/MMC mod for WRT54G/GL"
	default n

config TCONFIG_HFS
	bool "  HFS/HFS+ filesystem support "
	default n

config TCONFIG_UPS
	bool "  UPS Monitor"
	depends on TCONFIG_USB
	default n

config TCONFIG_DNSCRYPT
	bool "  DNScrypt-proxy"
	default n

config TCONFIG_NVRAM_64K
	bool "NVRAM_64K"
	default n

config TCONFIG_TOR
	bool "  TOR Project"
	default n

config TCONFIG_IPSEC
	bool "IPSec Support"
	default n

config TCONFIG_RAID
	bool "RAID Support: mdadm plus md modules"
	default n

config TCONFIG_MICROSD
	bool "Support SD card (RT-N66u only)"
	depends on TCONFIG_USB
	default n

config TCONFIG_USBAP
	bool "Include wl_high module"
	depends on TCONFIG_USB
	default n

config TCONFIG_REMOVE_USBAPP
	bool "Remove USB Application (samba/ftp/usb support page)"
	depends on TCONFIG_USBAP
	default n
```
