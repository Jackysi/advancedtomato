OUTPUT_ARCH(TARGET_ARCH)
ENTRY(startup)
SECTIONS {
	. = TEXT_START;
	.text : {
		_ftext = . ;
		text_start = .;
		*(.init)
		*(.text)
		*(.text.*)
		*(.fini)
		*(.glue_7t)
		*(.glue_7)
		*(.rdata)
		*(.rdata.*)
		*(.rodata)
		*(.rodata.*)
		. = ALIGN(16);
		_etext = .;
		text_end = .;
	}

	.data DATA_START: 
		AT (text_end)
	{
		data_start = .;
		_fdata = .;
		*(.data)
		*(.data.*)
		*(.sdata)
		data_end = .;
		_edata = .;
	}

	.bss : {
		_fbss = .;
		bss_start = .;
		*(.sbss)
		*(.scommon)
		*(.bss)
		*(.bss.*)
		*(COMMON)
		bss_end = .;
	}
	_end = .;
}
